## drivers/net/arm/Kconfig
```kconfig
#
# Acorn Network device configuration
#  These are for Acorn's Expansion card network interfaces
#
config ARM_AM79C961A
	bool "ARM EBSA110 AM79C961A support"
	depends on ARM && ARCH_EBSA110
	select CRC32
	help
	  If you wish to compile a kernel for the EBSA-110, then you should
	  always answer Y to this.

config ARM_ETHER1
	tristate "Acorn Ether1 support"
	depends on ARM && ARCH_ACORN
	help
	  If you have an Acorn system with one of these (AKA25) network cards,
	  you should say Y to this option if you wish to use it with Linux.

config ARM_ETHER3
	tristate "Acorn/ANT Ether3 support"
	depends on ARM && ARCH_ACORN
	help
	  If you have an Acorn system with one of these network cards, you
	  should say Y to this option if you wish to use it with Linux.

config ARM_ETHERH
	tristate "I-cubed EtherH/ANT EtherM support"
	depends on ARM && ARCH_ACORN
	select CRC32
	help
	  If you have an Acorn system with one of these network cards, you
	  should say Y to this option if you wish to use it with Linux.

config ARM_AT91_ETHER
	tristate "AT91RM9200 Ethernet support"
	depends on ARM && ARCH_AT91RM9200
	select MII
	help
	  If you wish to compile a kernel for the AT91RM9200 and enable
	  ethernet support, then you should always answer Y to this.

config ARM_KS8695_ETHER
	tristate "KS8695 Ethernet support"
	depends on ARM && ARCH_KS8695
	select MII
	help
	  If you wish to compile a kernel for the KS8695 and want to
	  use the internal ethernet then you should answer Y to this.

config EP93XX_ETH
	tristate "EP93xx Ethernet support"
	depends on ARM && ARCH_EP93XX
	select MII
	help
	  This is a driver for the ethernet hardware included in EP93xx CPUs.
	  Say Y if you are building a kernel for EP93xx based devices.

config IXP4XX_ETH
	tristate "Intel IXP4xx Ethernet support"
	depends on ARM && ARCH_IXP4XX && IXP4XX_NPE && IXP4XX_QMGR
	select PHYLIB
	help
	  Say Y here if you want to use built-in Ethernet ports
	  on IXP4xx processor.

config W90P910_ETH
	tristate "Nuvoton w90p910 Ethernet support"
	depends on ARM && ARCH_W90X900
	select PHYLIB
	select MII
	help
	  Say Y here if you want to use built-in Ethernet ports
	  on w90p910 processor.

config STM32_ETHER
	tristate "STM32 Ethernet support"
	depends on ARM && (ARCH_STM32 || ARCH_LPC18XX)
	select MII
	help
	  Say Y here if you want to use the built-in Ethernet port
	  on the STM32 processor.

config LPC178X_ETHER
	tristate "LPC178x/7x Ethernet support"
	depends on ARM && ARCH_LPC178X
	select MII
	help
	  Say Y here if you want to use the built-in Ethernet port
	  on the LPC178x/7x processor.

config M2S_ETH
	tristate "SmartFusion2 Ethernet support"
	depends on ARM && ARCH_M2S
	select MII
	help
	  Say Y here if you want to use the built-in Ethernet port
	  on the SmartFusion2 processor

config M2S_ETH_RX_NUM
	int "Number of RX buffers in SmartFusion2"
	depends on M2S_ETH
	default "4"
	help
	  Specify the number of RX buffers for SmartFusion2

config M2S_ETH_TX_NUM
	int "Number of TX buffers in SmartFusion2"
	depends on M2S_ETH
	default "4"
	help
	  Specify the number of TX buffers for SmartFusion2

config M2S_ETH_BUF_IN_ESRAM
	bool "Whether SmartFusion2 buffers reside in eSRAM"
	depends on M2S_ETH
	default y
	help
	  Specify Y if you want for the RX / TX buffer and decriptors
	  to reside in the SmartFusion2 embedded SRAM

config M2S_ETH_BUF_IN_ESRAM_BASE
	hex "Base address of SmartFusion2 buffers in eSRAM"
	depends on M2S_ETH_BUF_IN_ESRAM
	default "0x8000"
	help
	  Specify base address of the RX/ TX buffers and descriptors
	  in the SmartFusion2 embedded SRAM
```

## sound/soc/lpc3xxx/Kconfig
```kconfig
config SND_LPC3XXX_SOC
	tristate "SoC Audio for the NXP LPC32XX and LPC178X SoCs"
        depends on (ARCH_LPC32XX || ARCH_LPC178X || ARCH_LPC18XX) && SND_SOC
        help
          Say Y or M if you want to add support for codecs attached to
          the LPC3XXX/LPC178X I2S interface.  You will also need to select
          the audio interfaces to support below.

config SND_LPC3XXX_SOC_I2S_UDA1380
	bool

config SND_LPC3XXX_SOC_I2S_UDA1380_PHYTEC3250
        tristate "SoC Audio support for Phytec 3250 board with the UDA1380"
        depends on SND_LPC3XXX_SOC && ARCH_LPC32XX
	select SND_LPC3XXX_SOC_I2S_UDA1380
        select I2C
        select SND_SOC_UDA1380
        select SND_LPC32XX_USEI2S1
        select SND_LPC32XX_SLAVE_TX_CLK_TO_RX
        help
          Say Y or M here if you want to add support for SoC audio
          on the Phytec 3250 board. This requires an I2C channel connected
          to the I2C interface of the UDA1380 codec.

config SND_LPC3XXX_SOC_I2S_UDA1380_EALPC1788
	tristate "SoC Audio support for EA-LPC1788 board with the UDA1380"
	depends on SND_LPC3XXX_SOC && ARCH_LPC178X
	default y
	select SND_LPC3XXX_SOC_I2S_UDA1380
	select I2C
	select SND_SOC_UDA1380
	select GPIOLIB
	help
	  Say Y or M here if you want to add support for SoC audio
	  on the Embedded Artists LPC1788 Development Kit. This requires
	  an I2C channel connected to the I2C interface of the UDA1380
	  codec.

config SND_LPC32XX_USEI2S1
        bool "Use I2S1 channel instead of I2S0"
        depends on SND_LPC3XXX_SOC && ARCH_LPC32XX
        help
	  The LPC32XX has 2 I2S channels (0 and 1). Normally, I2S0 is
	  used for communications with an I2S codec. If I2S1 should be
	  used instead, select this option. For LPC32XX systems that
	  used the LCD interface, I2S1 must be used.

config SND_LPC32XX_USEI2S_SLAVE_MODETX
        bool "Use slave mode on the TX channel instead of master mode"
        depends on SND_LPC3XXX_SOC
	default n
        help
	  In this mode, the TX WS and bit clocks are driven from the audio
	  CODEC instead of from the LPC32x0/LPC178x. For most CODECs, this won't
	  be the case, but CODECs that have their own clocking may be able
	  to provide TX clocking.

config SND_LPC32XX_USEI2S_SLAVE_MODERX
        bool "Use slave mode on the RX channel instead of master mode"
        depends on SND_LPC3XXX_SOC
	default n
        help
	  In this mode, the RX WS and bit clocks are driven from the audio
	  CODEC instead of from the LPC32x0/LPC178x.

config SND_LPC32XX_SLAVE_TX_CLK_TO_RX
        bool "Enable TX WS clock during RX"
        depends on SND_LPC3XXX_SOC && ARCH_LPC32XX
	default n
        help
	  This enables the TX WS clock during RX transfers. Some CODECS use
	  the TX clock for internal clock or for RX clocking.

config SND_LPC3XXX_SOC_I2S_NAU8822
	bool "Enable I2S and NAU8822"
	depends on SND_LPC3XXX_SOC && ARCH_LPC18XX
```
