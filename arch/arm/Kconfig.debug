## arch/arm/Kconfig.debug
```kconfig
menu "Kernel hacking"

source "lib/Kconfig.debug"

# RMK wants arm kernels compiled with frame pointers or stack unwinding.
# If you know what you are doing and are willing to live without stack
# traces, you can get a slightly smaller kernel by setting this option to
# n, but then RMK will have to kill you ;).
config FRAME_POINTER
	bool
	default y if !ARM_UNWIND && !THUMB2_KERNEL
	help
	  If you say N here, the resulting kernel will be slightly smaller and
	  faster. However, if neither FRAME_POINTER nor ARM_UNWIND are enabled,
	  when a problem occurs with the kernel, the information that is
	  reported is severely limited.

config ARM_UNWIND
	bool "Enable stack unwinding support"
	depends on AEABI && EXPERIMENTAL
	default y
	help
	  This option enables stack unwinding support in the kernel
	  using the information automatically generated by the
	  compiler. The resulting kernel image is slightly bigger but
	  the performance is not affected. Currently, this feature
	  only works with EABI compilers. If unsure say Y.

config DEBUG_USER
	bool "Verbose user fault messages"
	help
	  When a user program crashes due to an exception, the kernel can
	  print a brief message explaining what the problem was. This is
	  sometimes helpful for debugging but serves no purpose on a
	  production system. Most people should say N here.

	  In addition, you need to pass user_debug=N on the kernel command
	  line to enable this feature.  N consists of the sum of:

	      1 - undefined instruction events
	      2 - system calls
	      4 - invalid data aborts
	      8 - SIGSEGV faults
	     16 - SIGBUS faults

config DEBUG_ERRORS
	bool "Verbose kernel error messages"
	depends on DEBUG_KERNEL
	help
	  This option controls verbose debugging information which can be
	  printed when the kernel detects an internal error. This debugging
	  information is useful to kernel hackers when tracking down problems,
	  but mostly meaningless to other people. It's safe to say Y unless
	  you are concerned with the code size or don't want to see these
	  messages.

config DEBUG_STACK_USAGE
	bool "Enable stack utilization instrumentation"
	depends on DEBUG_KERNEL
	help
	  Enables the display of the minimum amount of free stack which each
	  task has ever had available in the sysrq-T output.

config DEBUG_RVIDCC
	bool "Include the RealView ICE DCC channel device driver"
	depends on !DEBUG_ICEDCC
	help
	  Say Y here if you want a serial channel connected through ARM's
	  RealView ICE emulator through to your debugging host.

	  IMPORTANT: if you are not using one of the pre-configured platforms
	  (notably ARM's Integrator or Versatile Platform) then you will need to
	  configure interrupts for DCC and pass the IRQ numbers in the module
	  parameters 'txirq' and 'rxirq', assuming they have been wired into your
	  interrupt controller.

	  If interrupts are not used then a timed polling scheme is used. This
	  introduces poorer performance, using more CPU bandwidth and reducing
	  communication throughput on DCC.

	  This feature requires at least the RealView ICE 1.5 firmware version.

config DEBUG_DCC_KGDB
	bool "Use the RealView ICE DCC serial channel for KGDB debugging"
	depends on DEBUG_RVIDCC && KGDB
	help
	  Say Y here if you want to remotely debug the kernel using gdb and the
	  KGDB kernel debugging patches. Refer to the KGDB documentation for more
	  details.

	  Note that only one device can be enabled as the KGDB communications
	  device, so if this is selected, then KGDB on serial devices or Ethernet
	  must be deselected, or the kernel won't link.

config DEBUG_DCC_RAW
	bool "Disable virtual Ethernet on the RealView ICE DCC channel"
	depends on DEBUG_RVIDCC
	help
	  Say Y here if you want to disable the virtual Ethernet facility
	  of the RealView ICE.

	  The virtual Ethernet facility provides both a serial channel and an
	  Ethernet channel, and can be used for its serial channel even if
	  Ethernet is not required. Using this has the advantage over raw
	  DCC communications in that serial channel writes that do not have
	  an integral multiple of 4 bytes are not stuffed with nulls to make
	  the packet size.

	  DCC communicates in 32-bit words and, in raw mode, data is packed in
	  4 bytes per word. Individual write calls pack the data provided, padding
	  any remainder with nulls. Any protocol using this channel must tolerate
	  the embedded nulls. GDB is such a protocol, provided the driver is fed with
	  complete packets, and not one byte at a time.

# These options are only for real kernel hackers who want to get their hands dirty.
config DEBUG_LL
	bool "Kernel low-level debugging functions"
	depends on DEBUG_KERNEL
	help
	  Say Y here to include definitions of printascii, printch, printhex
	  in the kernel.  This is helpful if you are debugging code that
	  executes before the console is initialized.

config DEBUG_LL_CONSOLE
	bool "Kernel early console"
	depends on DEBUG_LL
	help
	  Say Y here if you want to have an early console using the Kernel
	  low-level debugging functions. Add earlyprintk to your kernel
	  parameters to enable this console.

config DEBUG_ICEDCC
	bool "Kernel low-level debugging via EmbeddedICE DCC channel"
	depends on DEBUG_LL
	help
	  Say Y here if you want the debug print routines to direct their
	  output to the EmbeddedICE macrocell's DCC channel using
	  co-processor 14. This is known to work on the ARM9 style ICE
	  channel.

	  It does include a timeout to ensure that the system does not
	  totally freeze when there is nothing connected to read.

config DEBUG_DC21285_PORT
	bool "Kernel low-level debugging messages via footbridge serial port"
	depends on DEBUG_LL && FOOTBRIDGE
	help
	  Say Y here if you want the debug print routines to direct their
	  output to the serial port in the DC21285 (Footbridge). Saying N
	  will cause the debug messages to appear on the first 16550
	  serial port.

config DEBUG_CLPS711X_UART2
	bool "Kernel low-level debugging messages via UART2"
	depends on DEBUG_LL && ARCH_CLPS711X
	help
	  Say Y here if you want the debug print routines to direct their
	  output to the second serial port on these devices.  Saying N will
	  cause the debug messages to appear on the first serial port.

config DEBUG_S3C_PORT
	depends on DEBUG_LL && PLAT_S3C
	bool "Kernel low-level debugging messages via S3C UART"
	help
	  Say Y here if you want debug print routines to go to one of the
	  S3C internal UARTs. The chosen UART must have been configured
	  before it is used.

config DEBUG_S3C_UART
	depends on PLAT_S3C
	int "S3C UART to use for low-level debug"
	default "0"
	help
	  Choice for UART for kernel low-level using S3C UARTS,
	  should be between zero and two. The port must have been
	  initialised by the boot-loader before use.

	  The uncompressor code port configuration is now handled
	  by CONFIG_S3C_LOWLEVEL_UART_PORT.

endmenu
```

## arch/arm/common/Kconfig
```kconfig
config ARM_GIC
	bool

config ARM_VIC
	bool

config ARM_VIC_NR
	int
	default 2
	depends on ARM_VIC
	help
	  The maximum number of VICs available in the system, for
	  power management.

config ARM_NVIC
	bool

config ARM_CORTEXM3
	bool
	select HAVE_CLK
	select COMMON_CLKDEV
	select GENERIC_TIME
	select GENERIC_CLOCKEVENTS

config ICST525
	bool

config ICST307
	bool

config SA1111
	bool
	select DMABOUNCE if !ARCH_PXA

config DMABOUNCE
	bool
	select ZONE_DMA

config TIMER_ACORN
	bool

config SHARP_LOCOMO
	bool

config SHARP_PARAM
	bool

config SHARP_SCOOP
	bool

config COMMON_CLKDEV
	bool
```

## arch/arm/mach-a2f/Kconfig
```kconfig
if ARCH_A2F

config MACH_A2F
	bool
	default y
	select ARM_NVIC if CPU_V7M
	help
	  Include support for the Actel A2F (SmartFusion) SoC


menu "A2F I/O interfaces"
	depends on ARCH_A2F


config A2F_MSS_UART0
	depends on ARCH_A2F && SERIAL_8250
	bool "Enable MSS UART0 port"
	default y
	help
	  Include support for the MSS UART0 port

config A2F_MSS_UART1
	depends on ARCH_A2F && SERIAL_8250
	bool "Enable MSS UART1 port"
	default n
	help
	  Include support for the MSS UART1 port

config A2F_MSS_ETHER
	depends on ARCH_A2F && CORE10100
	bool "Enable MSS Ethernet port"
	default y
	help
	  Include support for the MSS Core10100 Ethernet port

config A2F_MSS_SPI0
	depends on ARCH_A2F && SPI_A2F
	bool "Enable MSS SPI0 port"
	default y
	help
	  Include support for the MSS SPI0 port

config A2F_MSS_SPI1
	depends on ARCH_A2F && SPI_A2F
	bool "Enable MSS SPI1 port"
	default y
	help
	  Include support for the MSS SPI1 port

config A2F_MSS_I2C0
	depends on ARCH_A2F && I2C_A2F
	bool "Enable MSS I2C0 port"
	default y
	help
	  Include support for the MSS I2C0 port

config A2F_MSS_I2C1
	depends on ARCH_A2F && I2C_A2F
	bool "Enable MSS I2C1 port"
	default y
	help
	  Include support for the MSS I2C1 port

config A2F_FPGA_CINT
	depends on ARCH_A2F
	bool "Enable support for the FPGA CoreInterrupt IP"
	default y
	help
	  This option needs to be enabled if the FPGA fabric logic includes
	  an instance of the CoreInterrupt IP

config A2F_FPGA_CINT_BASE
	depends on A2F_FPGA_CINT
	hex "Base address of CoreInterrupt"
	default 0x40050000
	help
	  Define the base address of the CoreInterrupt IP block in the MSS
	  address space

config A2F_FPGA_DEMUX
	depends on A2F_FPGA_CINT
	bool "Enable the IRQ demultiplexer for CoreInterrupt"
	default y
	help
	  Define this option in case you have different IP blocks, all
	  generating interrupts to the MSS core using CoreInterrupt,
	  installed in the FPGA fabric. Alternatively, this option needs
	  to be enabled in case you have installed several instances of
	  a single IP block but a device driver for that IP does not
	  explicitly support interrupt sharing.


config A2F_FPGA_UART0
	depends on ARCH_A2F && SERIAL_8250
	bool "Enable FPGA-based Core16550 port 0"
	default n
	help
	  Include support for the FPGA-based Core16550 port 0

config A2F_FPGA_UART0_BASE
	depends on A2F_FPGA_UART0
	hex "Base address of the FPGA-based Core16550 port 0"
	default 0x40050200
	help
	  Define the base address of the FPGA-based Core16650 port 0
	  in the MSS address space

config A2F_FPGA_UART0_IRQ_SRC
	depends on A2F_FPGA_UART0
	int "IRQ source of FPGA-based Core16550 port 0"
	default 0
	help
	  Define the IRQ source within CoreInterrupt of the FPGA-based
	  Core16650 port 0

config A2F_FPGA_UART1
	depends on ARCH_A2F && SERIAL_8250
	bool "Enable FPGA-based Core16550 port 1"
	default n
	help
	  Include support for the FPGA-based Core16550 port 1

config A2F_FPGA_UART1_BASE
	depends on A2F_FPGA_UART1
	hex "Base address of the FPGA-based Core16550 port 1"
	default 0x40050300
	help
	  Define the base address of the FPGA-based Core16650 port 1
	  in the MSS address space

config A2F_FPGA_UART1_IRQ_SRC
	depends on A2F_FPGA_UART1
	int "IRQ source of FPGA-based Core16550 port 1"
	default 1
	help
	  Define the IRQ source within CoreInterrupt of the FPGA-based
	  Core16650 port 1

config A2F_CUART0
	depends on ARCH_A2F && SERIAL_A2F_CORE_UART
	bool "Enable A2F CoreUART0 port"
	default n

config A2F_CUART1
	depends on ARCH_A2F && SERIAL_A2F_CORE_UART
	bool "Enable A2F CoreUART1 port"
	default n

config A2F_CUART2
	depends on ARCH_A2F && SERIAL_A2F_CORE_UART
	bool "Enable A2F CoreUART2 port"
	default n

config A2F_CUART3
	depends on ARCH_A2F && SERIAL_A2F_CORE_UART
	bool "Enable A2F CoreUART3 port"
	default n

config A2F_CUART4
	depends on ARCH_A2F && SERIAL_A2F_CORE_UART
	bool "Enable A2F CoreUART4 port"
	default n

config A2F_CUART5
	depends on ARCH_A2F && SERIAL_A2F_CORE_UART
	bool "Enable A2F CoreUART5 port"
	default n

config A2F_CUART6
	depends on ARCH_A2F && SERIAL_A2F_CORE_UART
	bool "Enable A2F CoreUART6 port"
	default n

config A2F_CUART7
	depends on ARCH_A2F && SERIAL_A2F_CORE_UART
	bool "Enable A2F CoreUART7 port"
	default n

config A2F_MSS_GPIO
	depends on ARCH_A2F
	select GPIOLIB
	bool "Enable MSS GPIO"
	default y
	help
	  Include support for the MSS GPIOs

config A2F_FPGA_GPIO
	depends on ARCH_A2F
	select GPIOLIB
	bool "Enable FPGA GPIO"
	default n
	help
	  Include support for the FPGA GPIOs

config A2F_FPGA_GPIO_ADDR
	hex "Base address of SmartFusion FPGA Core GPIO block"
	depends on A2F_FPGA_GPIO
	default "0x40050200"
	help
	  Specify base address of SmartFusion FPGA Core GPIO block

endmenu

endif
```

## arch/arm/mach-kinetis/Kconfig
```kconfig
if ARCH_KINETIS

config MACH_KINETIS
	bool
	default y
	select ARM_NVIC if CPU_V7M
	help
	  Include support for the Freescale Kinetis MCUs

menu "Freescale Kinetis I/O interfaces"
	depends on ARCH_KINETIS

config KINETIS_UART0
	depends on ARCH_KINETIS && SERIAL_KINETIS
	bool "Enable Kinetis UART0 port"
	default n

config KINETIS_UART0_CTSRTS
	depends on KINETIS_UART0
	bool "Enable UART0 hardware flow control"
	default n

config KINETIS_UART1
	depends on ARCH_KINETIS && SERIAL_KINETIS
	bool "Enable Kinetis UART1 port"
	default n

config KINETIS_UART1_CTSRTS
	depends on KINETIS_UART1
	bool "Enable UART1 hardware flow control"
	default n

config KINETIS_UART2
	depends on ARCH_KINETIS && SERIAL_KINETIS
	bool "Enable Kinetis UART2 port"
	default y

config KINETIS_UART2_CTSRTS
	depends on KINETIS_UART2
	bool "Enable UART2 hardware flow control"
	default n

config KINETIS_UART3
	depends on ARCH_KINETIS && SERIAL_KINETIS
	bool "Enable Kinetis UART3 port"
	default n

config KINETIS_UART3_CTSRTS
	depends on KINETIS_UART3
	bool "Enable UART3 hardware flow control"
	default n

config KINETIS_UART4
	depends on ARCH_KINETIS && SERIAL_KINETIS
	bool "Enable Kinetis UART4 port"
	default n

config KINETIS_UART4_CTSRTS
	depends on KINETIS_UART4
	bool "Enable UART4 hardware flow control"
	default n

config KINETIS_UART5
	depends on ARCH_KINETIS && SERIAL_KINETIS
	bool "Enable Kinetis UART5 port"
	default n

config KINETIS_UART5_CTSRTS
	depends on KINETIS_UART5
	bool "Enable UART5 hardware flow control"
	default n

config KINETIS_MAC
	depends on ARCH_KINETIS && FEC
	bool "Enable Freescale Kinetis Ethernet port"
	default y

config KINETIS_FB
	depends on ARCH_KINETIS && FB_IMX
	bool "Enable Freescale Kinetis framebuffer"
	default n

config KINETIS_SPI_GPIO
	depends on ARCH_KINETIS && SPI_GPIO
	bool "Enable SPI buses emulated using GPIO"
	default n

config KINETIS_SPI2_GPIO
	depends on KINETIS_SPI_GPIO
	bool "Enable the Kinetis SPI2 bus emulated using GPIO"
	default n

config KINETIS_EDMA
	depends on ARCH_KINETIS
	bool "Enable Kinetis eDMA controller for peripherals"
	default y

endmenu

endif
```
