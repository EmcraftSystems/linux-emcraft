## arch/arm/mach-lpc178x/Kconfig
```kconfig
if ARCH_LPC178X

config MACH_LPC178X
	bool
	default y
	select ARM_NVIC if CPU_V7M
	help
	  Include support for the NXP LPC178x/7x SoCs

menu "LPC178x/7x I/O interfaces"
	depends on ARCH_LPC178X

config LPC178X_UART0
	depends on ARCH_LPC178X && SERIAL_8250
	bool "Enable LPC178x/7x UART0 port"
	default y

config LPC178X_UART1
	depends on ARCH_LPC178X && SERIAL_8250
	bool "Enable LPC178x/7x UART1 port"
	default n

config LPC178X_UART2
	depends on ARCH_LPC178X && SERIAL_8250
	bool "Enable LPC178x/7x UART2 port"
	default n

config LPC178X_UART3
	depends on ARCH_LPC178X && SERIAL_8250
	bool "Enable LPC178x/7x UART3 port"
	default n

config LPC178X_UART4
	depends on ARCH_LPC178X && SERIAL_8250
	bool "Enable LPC178x/7x UART4 port"
	default n

config LPC178X_MAC
	depends on ARCH_LPC178X && LPC178X_ETHER
	bool "Enable LPC178x/7x Ethernet port"
	default y

config LPC178X_SPI0
	depends on ARCH_LPC178X && SPI_PL022
	bool "Enable LPC178x/7x SSP/SPI0 port"
	default n

config LPC178X_I2C0
	depends on ARCH_LPC178X && I2C_LPC2K
	bool "Enable LPC178X I2C0 port"
	default n

config LPC178X_I2C1
	depends on ARCH_LPC178X && I2C_LPC2K
	bool "Enable LPC178X I2C1 port"
	default n

config LPC178X_I2C2
	depends on ARCH_LPC178X && I2C_LPC2K
	bool "Enable LPC178X I2C2 port"
	default n

config LPC178X_SD_DMA
	depends on ARCH_LPC178X && MMC_ARMMMCI
	bool "Use DMA for the SD Card Interface"
	default y

config LPC178X_WATCHDOG
	depends on ARCH_LPC178X && LPC2K_WATCHDOG
	bool "Enable LPC178x Watchdog"
	default n

endmenu

endif
```

## arch/arm/mach-lpc18xx/Kconfig
```kconfig
if ARCH_LPC18XX

config MACH_LPC18XX
	bool
	default y
	select ARM_NVIC if CPU_V7M
	help
	  Include support for the NXP LPC18xx MCUs and successors

menu "LPC18xx I/O interfaces"
	depends on ARCH_LPC18XX

config LPC18XX_UART0
	depends on ARCH_LPC18XX && SERIAL_8250
	bool "Enable LPC18xx USART0 port"
	default y

config LPC18XX_UART1
	depends on ARCH_LPC18XX && SERIAL_8250
	bool "Enable LPC18xx UART1 port"
	default n

config LPC18XX_UART2
	depends on ARCH_LPC18XX && SERIAL_8250
	bool "Enable LPC18xx USART2 port"
	default n

config LPC18XX_UART3
	depends on ARCH_LPC18XX && SERIAL_8250
	bool "Enable LPC18xx USART3 port"
	default n

config LPC18XX_MAC
	depends on ARCH_LPC18XX && STM32_ETHER
	bool "Enable LPC18xx Ethernet port"
	default y

config LPC18XX_SPI0
	depends on ARCH_LPC18XX && SPI_PL022
	bool "Enable LPC18xx SSP/SPI0 port"
	default n

config LPC18XX_SPI1
	depends on ARCH_LPC18XX && SPI_PL022
	bool "Enable LPC18xx SSP/SPI1 port"
	default n

config LPC18XX_I2C0
	depends on ARCH_LPC18XX && I2C_LPC2K
	bool "Enable LPC18XX I2C0 port"
	default n

config LPC18XX_I2C1
	depends on ARCH_LPC18XX && I2C_LPC2K
	bool "Enable LPC18XX I2C1 port"
	default n

endmenu

endif
```

## arch/arm/mach-m2s/Kconfig
```kconfig
if ARCH_M2S

config MACH_M2S
	bool
	default y
	select ARM_NVIC if CPU_V7M
	help
	  Include support for the Actel M2S (SmartFusion2) cSoC

menu "M2S I/O interfaces"
	depends on ARCH_M2S

config M2S_CACHE
	depends on ARCH_M2S 
	bool "Enable SmartFusion2 cache"
	default y
	help
	  Enable the SmartFusion2 on-chip cache

config M2S_MSS_UART0
	depends on ARCH_M2S && SERIAL_8250
	bool "Enable MSS UART0 port"
	default n
	help
	  Include support for the MSS UART0 port

config M2S_MSS_UART1
	depends on ARCH_M2S && SERIAL_8250
	bool "Enable MSS UART1 port"
	default y
	help
	  Include support for the MSS UART1 port

config M2S_MSS_MAC
	depends on ARCH_M2S && M2S_ETH
	bool "Enable MSS MAC port"
	default y
	help
	  Include support for the MSS MAC port

config M2S_MSS_SPI0
	depends on ARCH_M2S && SPI_M2S
	bool "Enable MSS SPI0 port"
	default y
	help
	  Include support for the MSS SPI0 port

config M2S_MSS_SPI1
	depends on ARCH_M2S && SPI_M2S
	bool "Enable MSS SPI1 port"
	default n
	help
	  Include support for the MSS SPI1 port


config M2S_MSS_I2C0
	depends on ARCH_M2S && I2C_A2F
	bool "Enable MSS I2C0 port"
	default y
	help
	  Include support for the MSS I2C0 port

config M2S_MSS_I2C1
	depends on ARCH_M2S && I2C_A2F
	bool "Enable MSS I2C1 port"
	default y
	help
	  Include support for the MSS I2C1 port

config M2S_MSS_USB
	depends on ARCH_M2S && USB_MUSB_SOC && M2S_MSS_GPIO
	bool "Enable MSS USB OTG port"
	default y
	help
	  Include support for the MSS USB OTG port

config M2S_MSS_GPIO
	depends on ARCH_M2S
	select GPIOLIB
	bool "Enable MSS GPIO"
	default y
	help
	  Include support for the MSS GPIOs

config M2S_FPGA_GPIO
	depends on ARCH_M2S
	select GPIOLIB
	bool "Enable FPGA GPIO"
	default n
	help
	  Include support for the FPGA GPIOs

config M2S_FPGA_GPIO_ADDR
	hex "Base address of SmartFusion2 Core GPIO block"
	depends on M2S_FPGA_GPIO
	default "0x30000000"
	help
	  Specify base address of SmartFusion2 Core GPIO block

endmenu

endif
```

## arch/arm/mach-mps/Kconfig
```kconfig
if ARCH_MPS

config MACH_MPS
	bool
	default y
	select ARM_NVIC if CPU_V7M
	help
	  Include support for the ARM Ltd. Microcontroller Prototyping
	  System platform.

config MACH_MPS_MODEL
	bool "Software model variant of the MPS platform"
	depends on MACH_MPS
	help
	  Enable this option if the platform you are running Linux on is
	  a software model rather than the real MPS hardware. There are
	  some minor differences in the memory map.

endif
```

## arch/arm/mach-realview/Kconfig
```kconfig
menu "RealView platform type"
	depends on ARCH_REALVIEW

config MACH_REALVIEW_EB
	bool "Support RealView/EB platform"
	select ARM_GIC
	help
	  Include support for the ARM(R) RealView Emulation Baseboard platform.

config REALVIEW_EB_ARM11MP
	bool "Support ARM11MPCore tile"
	depends on MACH_REALVIEW_EB
	help
	  Enable support for the ARM11MPCore tile on the Realview platform.

config REALVIEW_EB_ARM11MP_REVB
	bool "Support ARM11MPCore RevB tile"
	depends on REALVIEW_EB_ARM11MP
	default n
	help
	  Enable support for the ARM11MPCore RevB tile on the Realview
	  platform. Since there are device address differences, a
	  kernel built with this option enabled is not compatible with
	  other revisions of the ARM11MPCore tile.

config MACH_REALVIEW_PB11MP
	bool "Support RealView/PB11MPCore platform"
	select ARM_GIC
	help
	  Include support for the ARM(R) RealView MPCore Platform Baseboard.
	  PB11MPCore is a platform with an on-board ARM11MPCore and has
	  support for PCI-E and Compact Flash.

config MACH_REALVIEW_PB1176
	bool "Support RealView/PB1176 platform"
	select ARM_GIC
	help
	  Include support for the ARM(R) RealView ARM1176 Platform Baseboard.

config MACH_REALVIEW_PBA8
	bool "Support RealView/PB-A8 platform"
	select ARM_GIC
	help
	  Include support for the ARM(R) RealView Cortex-A8 Platform Baseboard.
	  PB-A8 is a platform with an on-board Cortex-A8 and has support for
	  PCI-E and Compact Flash.

config REALVIEW_PHYS_OFFSET
	hex "Physical base address for the RealView platform"
	default "0x00000000"
	help
	  RealView boards like PB11MPCore have 512MB of RAM available
	  contiguously at 0x70000000. Half of the memory is mirrored
	  at 0x00000000 for backwards compatibility. Use this option
	  to change the physical base address so that the full amount
	  of RAM is available to Linux.

endmenu
```

## arch/arm/mach-stm32/Kconfig
```kconfig
if ARCH_STM32

config MACH_STM32
	bool
	default y
	select ARM_NVIC if CPU_V7M
	help
	  Include support for the STMicro STM32F2 microcontroller

config ARCH_STM32F1
	bool "Support STM32F1 instead of STM32F2"
	default n
	depends on ARCH_STM32
	help
	  Build kernel for the STMicro STM32F1 MCU instead of STM32F2

config ARCH_STM32F7
	bool "Support STM32F7"
	default n
	depends on ARCH_STM32 && !ARCH_STM32F1
	select DMAMEM
	select CPU_CACHE_V7M
	help
	  Build kernel for the STMicro STM32F7 MCU

menu "STM32 I/O interfaces"
	depends on ARCH_STM32

config STM32_DMA
	depends on ARCH_STM32
	bool "Enable STM32 DMA controller for peripherals"
	default n

config STM32_USART1
	depends on ARCH_STM32 && SERIAL_STM32
	bool "Enable STM32 USART1 port"
	default n

config STM32_USART2
	depends on ARCH_STM32 && SERIAL_STM32
	bool "Enable STM32 USART2 port"
	default n

config STM32_USART3
	depends on ARCH_STM32 && SERIAL_STM32
	bool "Enable STM32 USART3 port"
	default y

config STM32_USART4
	depends on ARCH_STM32 && SERIAL_STM32
	bool "Enable STM32 USART4 port"
	default n

config STM32_USART5
	depends on ARCH_STM32 && SERIAL_STM32 && !ARCH_STM32F1
	bool "Enable STM32 USART5 port"
	default n

config STM32_USART6
	depends on ARCH_STM32 && SERIAL_STM32 && !ARCH_STM32F1
	bool "Enable STM32 USART6 port"
	default n

config STM32_USART7
	depends on ARCH_STM32 && SERIAL_STM32 && !ARCH_STM32F1
	bool "Enable STM32 USART7 port"
	default n

config STM32_USART8
	depends on ARCH_STM32 && SERIAL_STM32 && !ARCH_STM32F1
	bool "Enable STM32 USART8 port"
	default n

config STM32_MAC
	depends on ARCH_STM32 && STM32_ETHER
	bool "Enable STM32 Ethernet port"
	default y

config STM32_SPI1
	depends on ARCH_STM32 && SPI_STM32
	bool "Enable STM32 SPI1 port"
	default n

config STM32_SPI2
	depends on ARCH_STM32 && SPI_STM32
	bool "Enable STM32 SPI2 port"
	default n

config STM32_SPI3
	depends on ARCH_STM32 && SPI_STM32
	bool "Enable STM32 SPI3 port"
	default n

config STM32_SPI4
	depends on ARCH_STM32 && SPI_STM32
	bool "Enable STM32 SPI4 port"
	default n

config STM32_SPI5
	depends on ARCH_STM32 && SPI_STM32
	bool "Enable STM32 SPI5 port"
	default n

config STM32_SPI6
	depends on ARCH_STM32 && SPI_STM32
	bool "Enable STM32 SPI6 port"
	default n

config STM32_I2C1
	depends on ARCH_STM32 && (I2C_STM32 || I2C_STM32F7) && !I2C_GPIO
	bool "Enable STM32 I2C1 port"
	default n

config STM32_I2C2
	depends on ARCH_STM32 && (I2C_STM32 || I2C_STM32F7)
	bool "Enable STM32 I2C2 port"
	default n

config STM32_I2C3
	depends on ARCH_STM32 && (I2C_STM32 || I2C_STM32F7)
	bool "Enable STM32 I2C3 port"
	default n

config STM32_I2C4
	depends on I2C_STM32F7
	bool "Enable STM32 I2C4 port"
	default n

config STM32_SD
	depends on ARCH_STM32 && MMC_ARMMMCI
	bool "Enable STM32 SD Card interface"
	default n

config STM32_SD_DMA
	depends on STM32_SD && STM32_DMA && MMC_BLOCK_BOUNCE
	bool "Use DMA for the SD Card Interface"
	default y

config STM32_RTC
	depends on ARCH_STM32 && RTC_DRV_STM32F2
	bool "Enable STM32 RTC"
	default n

config STM32_USB_OTG_FS
	depends on ARCH_STM32 && USB_DWC2
	bool "Enable STM32 USB OTG FS"
	default n

choice
	prompt "USB FS Role"
	depends on STM32_USB_OTG_FS
	help
	  Integrated USB Full-Speed controller mode

config STM32_USB_OTG_FS_HOST
	bool "Host"
	select USB_DWC2_HOST
	select USB_DWC2_PLATFORM

config STM32_USB_OTG_FS_DEVICE
	bool "Device"
	select USB_DWC2_PERIPHERAL
	select USB_GADGET
	select USB_GADGET_SELECTED

endchoice

config STM32_USB_OTG_HS
	depends on ARCH_STM32 && USB_DWC2
	bool "Enable STM32 USB OTG HS"
	default n

choice
	prompt "USB HS Role"
	depends on STM32_USB_OTG_HS
	help
	  Integrated USB High-Speed controller mode

config STM32_USB_OTG_HS_HOST
	bool "Host"
	select USB_DWC2_HOST
	select USB_DWC2_PLATFORM

config STM32_USB_OTG_HS_DEVICE
	bool "Device"
	select USB_DWC2_PERIPHERAL
	select USB_GADGET
	select USB_GADGET_SELECTED
	select USB_GADGET_DUALSPEED

endchoice

config STM32_GPIO
	depends on ARCH_STM32 && GPIOLIB
	bool "Enable STM32 GPIO"
	default y
	help
	  Include support for the STM32 GPIO

config STM32_GPIO_INT
	depends on STM32_GPIO
	bool "Enable STM32 GPIO interrupts"
	default y
	help
	  Include support for the STM32 GPIO interrupts

config STM32_FB
	depends on ARCH_STM32 && FB_STM32F4
	bool "Enable STM32F4x9 LTDC framebuffer"
	default n

endmenu

endif
```

## arch/arm/mach-vexpress/Kconfig
```kconfig
menu "ARM Versatile Express platform type"
	depends on ARCH_VEXPRESS

config MACH_VEXPRESS
	bool "Support ARM Versatile Express platform"
	select ARM_GIC
	select HAVE_PATA_PLATFORM
	select ARCH_SPARSEMEM_ENABLE if CPU_V7 && \
		!VEXPRESS_HIGH_PHYS_OFFSET && MMU
	select ZONE_DMA if SPARSEMEM
	help
	  Include support for the ARM(R) Versatile Express platform.

config VEXPRESS_HIGH_PHYS_OFFSET
	bool "High physical base address for the Versatile Express platform"
	depends on MMU
	default n
	help
	  Versatile Express boards have the RAM available at
	  0x60000000, 256MB of which being mirrored at 0x00000000.
	  This option allows the memory to be accessed contiguously
	  at the high physical offset.

config VEXPRESS_USE_TILE_CLCD
	bool "Use the CLCD Controller on the daughterboard"
	default y
	help
	  There are two CLCD controllers available on many Versatile
	  Express systems, one on the motherboard and one on the daughterboard.
	  This option controls which of these the kernel uses.

endmenu
```

## drivers/amba/Kconfig
```kconfig
config ARM_AMBA
	bool "ARM AMBA bus"
	---help---
	 This motherboard has AMBA bus support.

config ARM_AMBA_DMA
	bool "AMBA DMA"
	depends on ARM_AMBA && (ARCH_VERSATILE_PB || MACH_VERSATILE_AB)
	select ISA_DMA_API
	default y
	---help---
	 This motherboard has AMBA DMA support.
	 If you wish DMA capable drivers to use it,
	 say Y, otherwise N.


config ARM_AMBA_PL080
	bool "AMBA PrimeCell DMAC PL080" if (ARCH_VERSATILE_PB || MACH_VERSATILE_AB)
	depends on ARM_AMBA_DMA
	---help---
	 This board has an AMBA PrimeCell PL080 DMA Controller.
	 It will be used if AMBA DMA is selected.


config ARM_AMBA_PL041
	bool "AMBA PrimeCell AACI AC'97" if (ARCH_VERSATILE_PB || MACH_VERSATILE_AB)
	depends on ARM_AMBA
	---help---
	 This board has an AMBA PrimeCell Advanced Audio Codec Interface.
	 It can be selected under sound/Advanced Linux Sound Architecture/ALSA ARM devices.
```
